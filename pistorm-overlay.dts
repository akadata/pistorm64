/*
 * Device Tree Overlay for PiStorm
 * This overlay configures the PiStorm hardware bridge on Raspberry Pi
 */

/dts-v1/;
/plugin/;

/ {
	compatible = "brcm,bcm2835", "brcm,bcm2708", "brcm,bcm2709", "brcm,bcm2711", "raspberrypi,4-model-b";

	fragment@0 {
		target-path = "/";
		__overlay__ {
			pistorm: pistorm@0 {
				compatible = "akadata,pistorm";
				
				reg = <0x0 0x7e200000 0x0 0x100>,   /* gpio */
				      <0x0 0x7e101000 0x0 0x200>;   /* cprman */
				reg-names = "gpio", "cprman";
				
				pinctrl-names = "default";
				pinctrl-0 = <&pistorm_pins>;
				
				txn-in-progress-gpios = <&gpio 0 GPIO_ACTIVE_HIGH>;
				ipl-zero-gpios        = <&gpio 1 GPIO_ACTIVE_HIGH>;
				a0-gpios              = <&gpio 2 GPIO_ACTIVE_HIGH>;
				a1-gpios              = <&gpio 3 GPIO_ACTIVE_HIGH>;
				reset-gpios           = <&gpio 5 GPIO_ACTIVE_HIGH>;
				rd-gpios              = <&gpio 6 GPIO_ACTIVE_HIGH>;
				wr-gpios              = <&gpio 7 GPIO_ACTIVE_HIGH>;
				
				data-gpios = <&gpio 8 GPIO_ACTIVE_HIGH>,  <&gpio 9 GPIO_ACTIVE_HIGH>,
				             <&gpio 10 GPIO_ACTIVE_HIGH>, <&gpio 11 GPIO_ACTIVE_HIGH>,
				             <&gpio 12 GPIO_ACTIVE_HIGH>, <&gpio 13 GPIO_ACTIVE_HIGH>,
				             <&gpio 14 GPIO_ACTIVE_HIGH>, <&gpio 15 GPIO_ACTIVE_HIGH>,
				             <&gpio 16 GPIO_ACTIVE_HIGH>, <&gpio 17 GPIO_ACTIVE_HIGH>,
				             <&gpio 18 GPIO_ACTIVE_HIGH>, <&gpio 19 GPIO_ACTIVE_HIGH>,
				             <&gpio 20 GPIO_ACTIVE_HIGH>, <&gpio 21 GPIO_ACTIVE_HIGH>,
				             <&gpio 22 GPIO_ACTIVE_HIGH>, <&gpio 23 GPIO_ACTIVE_HIGH>;
				
				akadata,gpclk-src = <5>;
				akadata,gpclk-div = <6>;
			};
			
			pistorm_pins: pistorm-pins {
				brcm,pins = <4>;          /* GPIO4 */
				brcm,function = <4>;      /* ALT0 for GPCLK0 */
				brcm,pull = <0>;          /* no pull */
			};
		};
	};
};