## Documentation/devicetree/bindings/misc/akadata,pistorm.yaml
```yaml
# Device Tree Binding for PiStorm
%YAML 1.2
---
$id: http://devicetree.org/schemas/misc/akadata,pistorm.yaml#
$schema: http://devicetree.org/meta-schemas/core.yaml#

title: PiStorm - Amiga to Raspberry Pi bridge controller

maintainers:
  - Andrew Smalley <andrew@akadata.ltd>

description: |
  The PiStorm is a hardware bridge that connects an Amiga computer to a
  Raspberry Pi, allowing the Pi to act as a co-processor for the Amiga.
  This binding describes the device tree representation of the PiStorm
  controller on Raspberry Pi platforms.

properties:
  compatible:
    enum:
      - akadata,pistorm

  clocks:
    description: Reference to the GPCLK0 clock
    maxItems: 1

  clock-names:
    items:
      - const: gpclk

  pinctrl-names:
    items:
      - const: default
      - const: bus-out
      - const: bus-in

  pinctrl-0:
    description: Default pinctrl state for pins (clock pin muxed to GPCLK0, data pins as input)
    $ref: /schemas/types.yaml#/definitions/phandle-array

  pinctrl-1:
    description: Pinctrl state for data output (data pins as output)
    $ref: /schemas/types.yaml#/definitions/phandle-array

  pinctrl-2:
    description: Pinctrl state for data input (data pins as input)
    $ref: /schemas/types.yaml#/definitions/phandle-array

  txn-in-progress-gpios:
    description: GPIO for transaction in progress signal (input)
    maxItems: 1

  ipl-zero-gpios:
    description: GPIO for interrupt priority level zero signal (input)
    maxItems: 1

  a0-gpios:
    description: GPIO for address bit 0 (output)
    maxItems: 1

  a1-gpios:
    description: GPIO for address bit 1 (output)
    maxItems: 1

  reset-gpios:
    description: GPIO for reset signal (output)
    maxItems: 1

  rd-gpios:
    description: GPIO for read signal (output)
    maxItems: 1

  wr-gpios:
    description: GPIO for write signal (output)
    maxItems: 1

  data-gpios:
    description: Array of 16 GPIOs for data bus (D0-D15, bidirectional)
    minItems: 16
    maxItems: 16

  txn-timeout-ms:
    description: Transaction timeout in milliseconds (default 500ms)
    $ref: /schemas/types.yaml#/definitions/uint32
    default: 500

  reset-pulse-ms:
    description: Reset pulse duration in milliseconds (default 100ms)
    $ref: /schemas/types.yaml#/definitions/uint32
    default: 100

required:
  - compatible
  - txn-in-progress-gpios
  - ipl-zero-gpios
  - a0-gpios
  - a1-gpios
  - reset-gpios
  - rd-gpios
  - wr-gpios
  - data-gpios

additionalProperties: false

examples:
  - |
    #include <dt-bindings/gpio/gpio.h>

    pistorm: pistorm {
        compatible = "akadata,pistorm";

        clocks = <&gpio_clk 0>;     /* GPCLK0 from clock manager */
        clock-names = "gpclk";

        pinctrl-names = "default", "bus-out", "bus-in";
        pinctrl-0 = <&pistorm_default_pins>;
        pinctrl-1 = <&pistorm_bus_out_pins>;
        pinctrl-2 = <&pistorm_bus_in_pins>;

        txn-in-progress-gpios = <&gpio 0 GPIO_ACTIVE_HIGH>;
        ipl-zero-gpios        = <&gpio 1 GPIO_ACTIVE_HIGH>;
        a0-gpios              = <&gpio 2 GPIO_ACTIVE_HIGH>;
        a1-gpios              = <&gpio 3 GPIO_ACTIVE_HIGH>;
        reset-gpios           = <&gpio 5 GPIO_ACTIVE_HIGH>;
        rd-gpios              = <&gpio 6 GPIO_ACTIVE_HIGH>;
        wr-gpios              = <&gpio 7 GPIO_ACTIVE_HIGH>;

        data-gpios = <&gpio 8 GPIO_ACTIVE_HIGH>,  <&gpio 9 GPIO_ACTIVE_HIGH>,
                     <&gpio 10 GPIO_ACTIVE_HIGH>, <&gpio 11 GPIO_ACTIVE_HIGH>,
                     <&gpio 12 GPIO_ACTIVE_HIGH>, <&gpio 13 GPIO_ACTIVE_HIGH>,
                     <&gpio 14 GPIO_ACTIVE_HIGH>, <&gpio 15 GPIO_ACTIVE_HIGH>,
                     <&gpio 16 GPIO_ACTIVE_HIGH>, <&gpio 17 GPIO_ACTIVE_HIGH>,
                     <&gpio 18 GPIO_ACTIVE_HIGH>, <&gpio 19 GPIO_ACTIVE_HIGH>,
                     <&gpio 20 GPIO_ACTIVE_HIGH>, <&gpio 21 GPIO_ACTIVE_HIGH>,
                     <&gpio 22 GPIO_ACTIVE_HIGH>, <&gpio 23 GPIO_ACTIVE_HIGH>;

        txn-timeout-ms = <500>;
        reset-pulse-ms = <100>;
    };

    pistorm_default_pins: pistorm-default-pins {
        pins = "GPIO4";
        function = "gpclk0";
    };

    pistorm_bus_out_pins: pistorm-bus-out-pins {
        pins = "GPIO8", "GPIO9", "GPIO10", "GPIO11", "GPIO12", "GPIO13",
               "GPIO14", "GPIO15", "GPIO16", "GPIO17", "GPIO18", "GPIO19",
               "GPIO20", "GPIO21", "GPIO22", "GPIO23";
        function = "gpio";
    };

    pistorm_bus_in_pins: pistorm-bus-in-pins {
        pins = "GPIO8", "GPIO9", "GPIO10", "GPIO11", "GPIO12", "GPIO13",
               "GPIO14", "GPIO15", "GPIO16", "GPIO17", "GPIO18", "GPIO19",
               "GPIO20", "GPIO21", "GPIO22", "GPIO23";
        function = "gpio";
    };
```

## Documentation/devicetree/bindings/misc/pistorm.yaml
```yaml
# Device Tree Binding for PiStorm
%YAML 1.2
---
$id: http://devicetree.org/schemas/misc/pistorm.yaml#
$schema: http://devicetree.org/meta-schemas/core.yaml#

title: PiStorm - Amiga to Raspberry Pi bridge controller

maintainers:
  - PiStorm Community <pistorm@example.com>

description: |
  The PiStorm is a hardware bridge that connects an Amiga computer to a
  Raspberry Pi, allowing the Pi to act as a co-processor for the Amiga.
  This binding describes the device tree representation of the PiStorm
  controller on Raspberry Pi platforms.

properties:
  compatible:
    enum:
      - akadata,pistorm
      - pistorm,pistorm-v1

  reg:
    description: |
      Base address and size of the GPIO and CPRMAN register regions.
      The first region is the GPIO registers, the second is the CPRMAN
      (Clock Peripheral Resource MANager) registers.
    items:
      - description: GPIO registers
      - description: CPRMAN registers (optional)

  reg-names:
    items:
      - const: gpio
      - const: cprman

  pinctrl-names:
    items:
      - const: default

  pinctrl-0:
    description: Reference to the pinctrl state for configuring GPIO pins

  txn-in-progress-gpios:
    description: GPIO for transaction in progress signal
    maxItems: 1

  ipl-zero-gpios:
    description: GPIO for interrupt priority level zero signal
    maxItems: 1

  a0-gpios:
    description: GPIO for address bit 0
    maxItems: 1

  a1-gpios:
    description: GPIO for address bit 1
    maxItems: 1

  reset-gpios:
    description: GPIO for reset signal
    maxItems: 1

  rd-gpios:
    description: GPIO for read signal
    maxItems: 1

  wr-gpios:
    description: GPIO for write signal
    maxItems: 1

  data-gpios:
    description: Array of 16 GPIOs for data bus (D0-D15)
    minItems: 16
    maxItems: 16

  akadata,gpclk-src:
    description: GPCLK source clock (default 5 for PLLC)
    $ref: /schemas/types.yaml#/definitions/uint32
    default: 5

  akadata,gpclk-div:
    description: GPCLK integer divider (default 6 for ~200MHz)
    $ref: /schemas/types.yaml#/definitions/uint32
    default: 6

required:
  - compatible
  - reg
  - reg-names
  - pinctrl-names
  - pinctrl-0
  - txn-in-progress-gpios
  - ipl-zero-gpios
  - a0-gpios
  - a1-gpios
  - reset-gpios
  - rd-gpios
  - wr-gpios
  - data-gpios

examples:
  - |
    #include <dt-bindings/gpio/gpio.h>
    
    pistorm@0 {
        compatible = "akadata,pistorm";
        
        reg = <0x0 0x7e200000 0x0 0x100>,   /* gpio */
              <0x0 0x7e101000 0x0 0x200>;   /* cprman */
        reg-names = "gpio", "cprman";
        
        pinctrl-names = "default";
        pinctrl-0 = <&pistorm_pins>;
        
        txn-in-progress-gpios = <&gpio 0 GPIO_ACTIVE_HIGH>;
        ipl-zero-gpios        = <&gpio 1 GPIO_ACTIVE_HIGH>;
        a0-gpios              = <&gpio 2 GPIO_ACTIVE_HIGH>;
        a1-gpios              = <&gpio 3 GPIO_ACTIVE_HIGH>;
        reset-gpios           = <&gpio 5 GPIO_ACTIVE_HIGH>;
        rd-gpios              = <&gpio 6 GPIO_ACTIVE_HIGH>;
        wr-gpios              = <&gpio 7 GPIO_ACTIVE_HIGH>;
        
        data-gpios = <&gpio 8 GPIO_ACTIVE_HIGH>,  <&gpio 9 GPIO_ACTIVE_HIGH>,
                     <&gpio 10 GPIO_ACTIVE_HIGH>, <&gpio 11 GPIO_ACTIVE_HIGH>,
                     <&gpio 12 GPIO_ACTIVE_HIGH>, <&gpio 13 GPIO_ACTIVE_HIGH>,
                     <&gpio 14 GPIO_ACTIVE_HIGH>, <&gpio 15 GPIO_ACTIVE_HIGH>,
                     <&gpio 16 GPIO_ACTIVE_HIGH>, <&gpio 17 GPIO_ACTIVE_HIGH>,
                     <&gpio 18 GPIO_ACTIVE_HIGH>, <&gpio 19 GPIO_ACTIVE_HIGH>,
                     <&gpio 20 GPIO_ACTIVE_HIGH>, <&gpio 21 GPIO_ACTIVE_HIGH>,
                     <&gpio 22 GPIO_ACTIVE_HIGH>, <&gpio 23 GPIO_ACTIVE_HIGH>;
        
        akadata,gpclk-src = <5>;
        akadata,gpclk-div = <6>;
    };
    
    pistorm_pins: pistorm-pins {
        brcm,pins = <4>;          /* GPIO4 */
        brcm,function = <4>;      /* ALT0 for GPCLK0 */
        brcm,pull = <0>;          /* no pull */
    };
```

## drivers/misc/pistorm/Kconfig
```kconfig
#
# PiStorm configuration
#

config PISTORM
	tristate "PiStorm - Amiga to Raspberry Pi bridge support"
	depends on ARCH_BCM2835 || ARCH_BCM2711 || COMPILE_TEST
	select GPIOLIB
	select PINCTRL
	help
	  Say Y or M here if you want to support the PiStorm hardware
	  bridge that connects an Amiga computer to a Raspberry Pi,
	  allowing the Pi to act as a co-processor for the Amiga.

	  If you are not using this hardware, say N.
```
