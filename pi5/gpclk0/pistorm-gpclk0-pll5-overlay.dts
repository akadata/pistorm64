/dts-v1/;
/plugin/;

/*
 * Attempt to drive GPCLK0 (GPIO4) from RP1 PLL_SYS via a /5 divisor (~200 MHz).
 * If the kernel rejects the parent, clk_rate will stay ~50 MHz (xosc).
 */

/ {
	compatible = "brcm,bcm2712";

	/* Try to reparent clksrc_gp0 to pll_sys and request 200 MHz */
	fragment@0 {
		target = <&rp1_gpclksrc0>;
		__overlay__ {
			assigned-clock-parents = <&rp1_clocks 3>; /* RP1_PLL_SYS */
			assigned-clock-rates   = <200000000>;
		};
	};

	fragment@1 {
		target-path = "/";
		__overlay__ {
			pistorm_gpclk0_pll5: pistorm-gpclk0-pll5 {
				compatible = "pistorm,gpclk0";
				status = "okay";

				pinctrl-names = "default";
				pinctrl-0 = <&rp1_gpclksrc0_gpio4>;

				/* RP1 clocks provider: see dt-bindings/clock/rp1.h */
				clocks = <&rp1_clocks 33>, /* RP1_CLK_GP0 */
					 <&rp1_clocks 3>;  /* RP1_PLL_SYS */
				clock-names = "gpclk", "parent";

				/* Requested output frequency. */
				clock-frequency = <200000000>;
			};
		};
	};

	__overrides__ {
		freq = <&pistorm_gpclk0_pll5>,"clock-frequency:0";
	};
};
